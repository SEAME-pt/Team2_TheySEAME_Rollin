VERSION "1.0"

NS_ :

BS_:

BU_: STM32 RASPI

BO_ 256 SpeedMsg: 8 RASPI
 SG_ speed : 0|16@1+ (1,0) [0|200] "hm/h" STM32

BO_ 257 BatteryMsg: 8 RASPI
 SG_ StateOfCharge : 0|8@1+ (1,0) [0|100] "%" STM32

BO_ 258 ThrottleMsg: 8 RASPI
 SG_ throttle : 0|16@1+ (1,0) [0|100] "%" STM32

BO_ 259 AngleMsg: 8 RASPI
 SG_ Angle : 0|16@1- (1,0) [-450|450] "deg" STM32

BO_ 260 DrivingModeMsg: 8 RASPI
 SG_ DrivingMode : 0|8@1+ (1,0) [0|2] "" STM32

VAL_ 260 DrivingMode 0 "MANUAL" 1 "AI_ASSIST";
